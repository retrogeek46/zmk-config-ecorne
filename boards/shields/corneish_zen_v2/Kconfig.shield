## boards/shields/corneish_zen_v2/Kconfig.shield
```kconfig
#
# Copyright (c) 2022 Darryl deHaan
# SPDX-License-Identifier: MIT
#

config SHIELD_CORNEISH_ZEN_V1_LEFT
    bool "corneish zen left v1"
    depends on SOC_NRF52840_QIAA
    select SHIELD_CORNEISH_ZEN_LEFT

config SHIELD_CORNEISH_ZEN_V1_RIGHT
    bool "corneish zen right v1"
    depends on SOC_NRF52840_QIAA
    select SHIELD_CORNEISH_ZEN_RIGHT

config SHIELD_CORNEISH_ZEN_V2_LEFT
    bool "corneish zen left v2"
    depends on SOC_NRF52840_QIAA
    select SHIELD_CORNEISH_ZEN_LEFT

config SHIELD_CORNEISH_ZEN_V2_RIGHT
    bool "corneish zen right v2"
    depends on SOC_NRF52840_QIAA
    select SHIELD_CORNEISH_ZEN_RIGHT

config SHIELD_CORNEISH_ZEN_V2_PAD
    bool "corneish zen pad v2"
    depends on SOC_NRF52840_QIAA
    select SHIELD_CORNEISH_ZEN_PAD
```
